## capdl-loader-app/Kconfig
```kconfig
#
# Copyright 2017, Data61
# Commonwealth Scientific and Industrial Research Organisation (CSIRO)
# ABN 41 687 119 230.
#
# This software may be distributed and modified according to the terms of
# the BSD 2-Clause license. Note that NO WARRANTY is provided.
# See "LICENSE_BSD2.txt" for details.
#
# @TAG(DATA61_BSD)
#

menuconfig MODULE_CAPDL_LOADER
    bool "CapDL Loader"
    depends on LIB_SEL4 && HAVE_LIBC && LIB_CPIO && LIB_ELF && LIB_SEL4_MUSLC_SYS && LIB_SEL4_SIMPLE && LIB_SEL4_PLAT_SUPPORT && LIB_PLATSUPPORT && ( (LIB_SEL4_SIMPLE_DEFAULT && !KERNEL_STABLE) || (LIB_SEL4_SIMPLE_STABLE && KERNEL_STABLE)) && HAVE_LIB_SEL4_DEBUG
    help
        Build the CapDL loader application

choice
    prompt "Calling convention"
    depends on MODULE_CAPDL_LOADER
    default CAPDL_LOADER_CC_STANDARD
    help
        Select the calling convention that loaded processes are expecting. If
        you select the register convention you will be limited to passing four
        arguments to processes and their stack frames will not need to be
        mapped in during thread configuration.

    config CAPDL_LOADER_CC_STANDARD
        bool "standard"

    config CAPDL_LOADER_CC_REGISTERS
        bool "registers (maximum 4 arguments)"

endchoice

config CAPDL_LOADER_MAX_OBJECTS
    int "Maximum objects"
    default 4096
    depends on MODULE_CAPDL_LOADER
    help
        Maximum number of objects that can be handled by the loader. Note that
        there is an upper limit on this based on the size of the initialiser's
        CNode.

config CAPDL_LOADER_MAX_IRQS
    int "Maximum interrupts"
    default 256
    depends on MODULE_CAPDL_LOADER
    help
        Maximum number of interrupts supported. The initialiser will only
        create interrupt handlers for interrupts up to this maximum.

config CAPDL_LOADER_ALLOW_NO_CSPACE
    bool "Allow threads without CSpaces"
    default n
    depends on MODULE_CAPDL_LOADER
    help
        Allow threads to be specified in CapDL with no CSpace and have them
        configured as such by the initialiser. Note that this requires a kernel
        that supports threads without CSpaces.

config CAPDL_LOADER_WRITEABLE_PAGES
    bool "Map all pages with grant permission as writeable"
    default n
    depends on MODULE_CAPDL_LOADER
    help
        CapDL Loader will map all pages as writeable if the cap has grant permissions.
        This is currently used to enable instruction and data rewriting by an external debugger such as GDB.

config CAPDL_LOADER_PRINT_DEVICE_INFO
    bool "Print device frame info on startup"
    default n
    depends on MODULE_CAPDL_LOADER && !CAPDL_LOADER_VERIFIED
    help
        Dump device frame information on startup for the purposes of debugging.

config CAPDL_LOADER_PRINT_UNTYPEDS
    bool "Print untyped object info on startup"
    default n
    depends on MODULE_CAPDL_LOADER && !CAPDL_LOADER_VERIFIED
    help
        Dump untyped object information on startup for the purposes of debugging.

config CAPDL_LOAD_PRINT_CAPDL_OBJECTS
    bool "Print capDL objects as they are created"
    default n
    depends on MODULE_CAPDL_LOADER && !CAPDL_LOADER_VERIFIED
    help
        Display verbose capDL objects as they are created. Could help with debugging,
        but for large specs with lots of objects, this could slow things down significantly.
```
